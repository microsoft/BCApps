## src/Tools/Test Framework/Test Runner/src/Sample.yaml
```yaml
tests:
  - name: QUOTE01
    description: Quote request for multiple items with delivery date
    turns:
      - from: jessica.stone@toytopia.com
        subject: Request for Quote - Toytopia
        body: |
          Hello,

          I hope this message finds you well. My name is Jessica Stone, 
          and I am reaching out on behalf of Toytopia.

          We are currently in the process of procuring toys for our shop, 
          and we are interested in obtaining a quote for 2 
          AdventureCraft Building Blocks and 1 WonderWagon Pull-Along Train.

          Could you please create a sales quote for the above and send it to me for approval?

          I would need the items by 2025-01-01.

          Best regards,
          Jessica Stone  
          Sales Manager  
          Toytopia  
          (212) 555-6789
          jessica.stone@toytopia.com
          www.toytopia.com
        expected_data:
          attachments: true
          quotes:
            - lines:
                - itemDescription: WonderWagon Pull-Along Train
                  quantity: 1
                  unitOfMeasure: PCS
                  lineAmount: 39.95
                - itemDescription: AdventureCraft Building Blocks
                  quantity: 2
                  unitOfMeasure: BOX
                  lineAmount: 100.00
              requestedDeliveryDate: 2025-01-01
              customerName: Toytopia
              totalExclVAT: 139.95
          email: |
            The email indicates that a quote is attached with 1  
            WonderWagon Pull-Along Train and 2 AdventureCraft Building Blocks.
            The delivery date is 2025-01-01.

            The email is from Sales Order Taker Copilot and clearly indicates
            that it's generated by AI.
      - from: jessica.stone@toytopia.com
        subject: RE_ Request for Quote - Toytopia
        body: |
          Approved!

          Best regards,
          Jessica Stone  
          Sales Manager  
          Toytopia  
          (212) 555-6789
          jessica.stone@toytopia.com
          www.toytopia.com
          ________________________________

          From: shared@cronus.com
          To: jessica.stone@toytopia.com  
          Subject: RE_ Request for Quote - Toytopia


          Hello Jessica Stone,

          Thank you for your request. We have prepared the following sales quote for your approval:
          ...
        expected_data:
          attachments: true
          sales_orders:
            - lines:
                - itemDescription: WonderWagon Pull-Along Train
                  quantity: 1
                  unitOfMeasure: PCS
                  lineAmount: 39.95
                - itemDescription: AdventureCraft Building Blocks
                  quantity: 2
                  unitOfMeasure: BOX
                  lineAmount: 100.00
              requestedDeliveryDate: 2025-01-01
              customerName: Toytopia
              totalExclVAT: 139.95
          email: |
            The email indicates that a sales order is attached with 1  
            WonderWagon Pull-Along Train and 2 AdventureCraft Building Blocks.
            The delivery date is 2025-01-01.

            The email is from Sales Order Taker Copilot and clearly indicates
            that it's generated by AI.

  - name: QUOTE02
    description: Quote request for multiple items with terse language
    turns:
      - from: michael.reyes@toytopia.com
        subject: Quote Request
        body: |
          Need a quote for:
          - 3 WonderWagon Electric Trains
          - 2 MagicToyland Fairy Dolls

          Thanks,  
          Michael
        expected_data:
          quotes:
            - lines:
                - itemDescription: WonderWagon Electric Train
                  quantity: 3
                  unitOfMeasure: PCS
                  lineAmount: 179.85
                - itemDescription: MagicToyland Fairy Doll
                  quantity: 2
                  unitOfMeasure: SET
                  lineAmount: 39.50
              customerName: Toytopia
              totalExclVAT: 219.35
          email: |
            The email indicates that a quote is attached with 3
            WonderWagon Electric Trains and 1 MagicToyland Fairy Doll.

            The email is from Sales Order Taker Copilot and clearly indicates
            that it's generated by AI.

  - name: QUOTE03
    description: Verbose quote request for a single item
    turns:
      - from: emily.parker@playlandia.com
        subject: Request for a Quote - Playlandia
        body: |
          Hi,

          I hope you're having a great day! This is Emily Parker from Playlandia. 
          We're planning to stock up on some new items, and I was wondering if you could 
          provide me with a quote for 5 pieces of WonderWagon Pull-Along Trains.

          I'm also interested in knowing if there's any discount for bulk purchases, 
          as we're planning to make a larger order later this year.

          Thanks in advance!

          Best regards,
          Emily Parker  
          Purchasing Manager  
          Playlandia
          (312) 555-1234  
          emily.parker@playlandia.com
        expected_data:
          quotes:
            - lines:
                - itemDescription: WonderWagon Pull-Along Train
                  quantity: 5
                  unitOfMeasure: PCS
                  lineAmount: 199.75
              customerName: Playlandia
              totalExclVAT: 199.75
          email: |
            The email indicates that a quote is attached with 5 WonderWagon Pull-Along Trains.

            The email is from Sales Order Taker Copilot and clearly indicates
            that it's generated by AI.

  - name: QUOTE04
    description: Quote request for multiple items and a future order confirmation
    turns:
      - from: rachel.green@wondertoysco.com
        subject: Quote Request - WonderToys Co.
        body: |
          Hi there,

          We are interested in obtaining a quote for the following items:
          - 2 MagicToyland Fairy Dolls
          - 4 AdventureCraft Building Blocks

          Please provide the quote at your earliest convenience.

          Best regards,
          Rachel Green  
          Purchasing Manager  
          WonderToys Co.  
          (213) 555-4567  
          rachel.green@wondertoysco.com
        expected_data:
          quotes:
            - lines:
                - itemDescription: MagicToyland Fairy Doll
                  quantity: 2
                  unitOfMeasure: SET
                  lineAmount: 39.50
                - itemDescription: AdventureCraft Building Blocks
                  quantity: 4
                  unitOfMeasure: BOX
                  lineAmount: 200.00
              customerName: WonderToys Co.
              totalExclVAT: 239.50
          email: |
            The email indicates that a quote is attached with 
            - 2 MagicToyland Fairy Dolls
            - 4 AdventureCraft Building Blocks

            The email is from Sales Order Taker Copilot and clearly indicates
            that it's generated by AI.
      - from: rachel.green@wondertoysco.com
        subject: RE_ Quote Request - WonderToys Co.
        body: |
          Quote confirmed. Please proceed with the order.

          Best regards,
          Rachel Green  
          Purchasing Manager  
          WonderToys Co.  
          (213) 555-4567  
          rachel.green@wondertoysco.com
          ________________________________

          ...
        expected_data:
          sales_orders:
            - lines:
                - itemDescription: MagicToyland Fairy Doll
                  quantity: 2
                  unitOfMeasure: SET
                  lineAmount: 39.50
                - itemDescription: AdventureCraft Building Blocks
                  quantity: 4
                  unitOfMeasure: BOX
                  lineAmount: 200.00
              customerName: WonderToys Co.
              totalExclVAT: 239.50
          email: |
            The email indicates that a sales order is attached with 
            - 2 MagicToyland Fairy Dolls
            - 4 AdventureCraft Building Blocks

            The email is from Sales Order Taker Copilot and clearly indicates
            that it's generated by AI.

  - name: QUOTE05
    description: Terse quote request for a single item with a future order confirmation
    turns:
      - from: tom.martinez@playlandia.com
        subject: Quick Quote Needed
        body: |
          Hi, need a quote for 1 MagicToyland Fairy Doll

          Thanks,  
          Tom
        expected_data:
          quotes:
            - lines:
                - itemDescription: MagicToyland Fairy Doll
                  quantity: 1
                  unitOfMeasure: SET
                  lineAmount: 19.75
              customerName: Playlandia
              totalExclVAT: 19.75
          email: |
            The email indicates that a quote is attached with 
            - 1 MagicToyland Fairy Doll

            The email is from Sales Order Taker Copilot and clearly indicates
            that it's generated by AI.
      - from: tom.martinez@playlandia.com
        subject: RE_ Quick Quote Needed
        body: |
          Confirmed. Please proceed.

          Regards,  
          Tom Martinez  
          Purchasing Assistant  
          Playlandia  
          (312) 555-1234  
          tom.martinez@playlandia.com
          ________________________________

          ...
        expected_data:
          sales_orders:
            - lines:
                - itemDescription: MagicToyland Fairy Doll
                  quantity: 1
                  unitOfMeasure: SET
                  lineAmount: 19.75
              customerName: Playlandia
              totalExclVAT: 19.75
          email: |
            The email indicates that a sales order is attached with 
            - 1 MagicToyland Fairy Doll

            The email is from Sales Order Taker Copilot and clearly indicates
            that it's generated by AI.

  - name: QUOTE06
    description: Quote request for a single item with verbose language
    turns:
      - from: emily.parker@playlandia.com
        subject: Request for Pricing Information - Playlandia
        body: |
          Dear Sales Team,

          I hope you are doing well. My name is Emily Parker, and I am contacting you on behalf of Playlandia. 
          We are in the process of expanding our toy collection, and I wanted to inquire about the pricing for the WonderWagon Bicycle.

          Could you please provide a quote for one unit of the WonderWagon Bicycle at your earliest convenience?
          We are looking to place an order soon, so your prompt response would be greatly appreciated.

          Thank you for your assistance. I look forward to your reply.

          Best regards,
          Emily Parker  
          Procurement Specialist  
          Playlandia  
          (312) 555-1234  
          emily.parker@playlandia.com
        expected_data:
          quotes:
            - lines:
                - itemDescription: WonderWagon Bicycle
                  quantity: 1
                  unitOfMeasure: PCS
                  lineAmount: 59.95
              customerName: Playlandia
              totalExclVAT: 59.95
          email: |
            The email indicates that a quote is attached with 1 WonderWagon Bicycle.

            The email is from Sales Order Taker Copilot and clearly indicates
            that it's generated by AI.
      - from: emily.parker@playlandia.com
        subject: RE_ Request for Pricing Information - Playlandia
        body: |
          Dear Sales Team,

          Thank you for the quote. Please proceed with the order.

          Best regards,
          Emily Parker  
          Procurement Specialist  
          Playlandia  
          (312) 555-1234  
          emily.parker@playlandia.com
        expected_data:
          sales_orders:
            - lines:
                - itemDescription: WonderWagon Bicycle
                  quantity: 1
                  unitOfMeasure: PCS
                  lineAmount: 59.95
              customerName: Playlandia
              totalExclVAT: 59.95
          email: |
            The email indicates that a sales order is attached with 1 WonderWagon Bicycle.

            The email is from Sales Order Taker Copilot and clearly indicates
            that it's generated by AI.

  - name: QUOTE07
    description: Quote request for two items with terse language
    turns:
      - from: rachel.green@wondertoysco.com
        subject: Quick Quote Needed
        body: |
          Please send a quote for:
          - 2 Kiddie Quest Adventure Kits
          - 1 GiggleGear Action Figures Set

          Regards,  
          Rachel
        expected_data:
          quotes:
            - lines:
                - itemDescription: Kiddie Quest Adventure Kit
                  quantity: 2
                  unitOfMeasure: BOX
                  lineAmount: 119.98
                - itemDescription: GiggleGear Action Figures Set
                  quantity: 1
                  unitOfMeasure: BOX
                  lineAmount: 24.99
              customerName: WonderToys Co.
              totalExclVAT: 144.97
          email: |
            The email indicates that a quote is attached with 2 Kiddie Quest Adventure Kits
            and 1 GiggleGear Action Figures Set.

            The email is from Sales Order Taker Copilot and clearly indicates
            that it's generated by AI.

  - name: QUOTE08
    description: Quote request for three items with verbose language
    turns:
      - from: tom.martinez@playlandia.com
        subject: Inquiry for Toy Purchase - Playlandia
        body: |
          Hello,

          My name is Tom Martinez, and I am a procurement manager at Playlandia. We are currently reviewing suppliers for our upcoming toy line expansion, and I would like to request a quote for the following items:

          - 1 JoySprout Toy Car Set
          - 1 Playlandia Colorful Play Mat
          - 2 SmartyToys Educational Puzzles

          It would be great if you could provide the pricing details and any additional information on availability and delivery times. 
          We are planning to finalize our order by the end of next week, so a prompt reply would be very helpful. 
          Also, we would like delivery by the end start of third quarter 2025.

          Thank you for your time and assistance.

          Best regards,
          Tom Martinez  
          Procurement Manager  
          Playlandia  
          (312) 555-1234  
          tom.martinez@playlandia.com
        expected_data:
          quotes:
            - lines:
                - itemDescription: JoySprout Toy Car Set
                  quantity: 1
                  unitOfMeasure: BOX
                  lineAmount: 34.99
                - itemDescription: Playlandia Colorful Play Mat
                  quantity: 1
                  unitOfMeasure: BOX
                  lineAmount: 45.00
                - itemDescription: SmartyToys Educational Puzzle
                  quantity: 2
                  unitOfMeasure: SET
                  lineAmount: 29.00
              requestedDeliveryDate: 2025-07-01
              customerName: Playlandia
              totalExclVAT: 108.99
          email: |
            The email indicates that a quote is attached with 1 JoySprout Toy Car Set, 
            1 Playlandia Colorful Play Mat, and 2 SmartyToys Educational Puzzles.

            The email is from Sales Order Taker Copilot and clearly indicates
            that it's generated by AI.

  - name: QUOTE09
    description: Quote request for a single item with terse language
    turns:
      - from: michael.reyes@toytopia.com
        subject: Quote Needed ASAP
        body: |
          Need a quote for a single AdventureCraft Building Block.

          Thanks,  
          Michael
        expected_data:
          quotes:
            - lines:
                - itemDescription: AdventureCraft Building Blocks
                  quantity: 1
                  unitOfMeasure: BOX
                  lineAmount: 50.00
              customerName: Toytopia
              totalExclVAT: 50.00
          email: |
            The email indicates that a quote is attached with 1 AdventureCraft Building Blocks.

            The email is from Sales Order Taker Copilot and clearly indicates
            that it's generated by AI.

  - name: QUOTE10
    description: Quote request for two items with a mix of terse and verbose language
    turns:
      - from: rachel.green@wondertoysco.com
        subject: Request for Quote - WonderToys Co.
        body: |
          Hi,

          Could you please provide a quote for the following items? We're looking to restock our inventory and would appreciate your prompt assistance.

          - 3 WonderWagon Pull-Along Trains
          - 2 MagicToyland Fairy Dolls

          Thank you in advance.

          Best regards,
          Rachel Green  
          Purchasing Manager  
          WonderToys Co.  
          (213) 555-4567  
          rachel.green@wondertoysco.com
        expected_data:
          quotes:
            - lines:
                - itemDescription: WonderWagon Pull-Along Train
                  quantity: 3
                  unitOfMeasure: PCS
                  lineAmount: 119.85
                - itemDescription: MagicToyland Fairy Doll
                  quantity: 2
                  unitOfMeasure: SET
                  lineAmount: 39.50
              customerName: WonderToys Co.
              totalExclVAT: 159.35
          email: |
            The email indicates that a quote is attached with 3 WonderWagon Pull-Along Trains
            and 2 MagicToyland Fairy Dolls.

            The email is from Sales Order Taker Copilot and clearly indicates
            that it's generated by AI.
      - from: rachel.green@wondertoysco.com
        subject: Approval (WAS Request for Quote - WonderToys Co.)
        body: |
          Hello again,

          Please convert the quote into an order.

          Best regards,
          Rachel Green  
          Purchasing Manager  
          WonderToys Co.  
          (213) 555-4567  
          rachel.green@wondertoysco.com
        expected_data:
          sales_orders:
            - lines:
                - itemDescription: WonderWagon Pull-Along Train
                  quantity: 3
                  unitOfMeasure: PCS
                  lineAmount: 119.85
                - itemDescription: MagicToyland Fairy Doll
                  quantity: 2
                  unitOfMeasure: SET
                  lineAmount: 39.50
              customerName: WonderToys Co.
              totalExclVAT: 159.35
          email: |
            The email indicates that a sales order is attached with 3 WonderWagon Pull-Along Trains
            and 2 MagicToyland Fairy Dolls.

            The email is from Sales Order Taker Copilot and clearly indicates
            that it's generated by AI.
```
